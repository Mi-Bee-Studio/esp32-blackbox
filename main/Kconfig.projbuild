## main/Kconfig.projbuild
```kconfig
# ESP32 Blackbox 配置菜单
# 通过 menuconfig 可配置 WiFi 配网热点和连接重试参数

menu "ESP32 Blackbox Configuration"

    config ESP_AP_SSID
        string "Config Portal AP SSID"
        default "ESP32_Blackbox"
        help
            WiFi 配置门户的接入点名称（SSID）。
            设备启动配网模式时创建的热点的名称。

    config ESP_AP_PASSWORD
        string "Config Portal AP Password"
        default "12345678"
        help
            WiFi 配置门户的接入点密码。
            留空可创建开放网络（无密码）。

    config ESP_MAXIMUM_RETRY
        int "Maximum STA connection retry"
        default 5
        help
            WiFi 客户端（STA）模式连接失败后的最大重试次数。
            超过最大重试次数后将回退到 AP 配网模式。

    config ESP_BOARD_TEST
        bool "Run board self-test on startup"
        default y if IDF_TARGET_ESP32C6
        default n if IDF_TARGET_ESP32C3
        help
            启动时运行硬件自检，验证 NVS、WiFi、DNS、HTTP、TCP 等子系统。
            ESP32-C6 (Seeed XIAO) 默认启用，用于新板卡验证。
            ESP32-C3 默认关闭，避免影响正常启动速度。

endmenu
```

## sdkconfig.defaults
```kconfig
# ESP32 Blackbox Default Configuration

# WiFi AP (config portal)
CONFIG_ESP_AP_SSID="ESP32_Blackbox"
CONFIG_ESP_AP_PASSWORD="12345678"
CONFIG_ESP_MAXIMUM_RETRY=5

# FreeRTOS
CONFIG_FREERTOS_HZ=1000

# LWIP
CONFIG_LWIP_MAX_SOCKETS=16

# mbedTLS
CONFIG_MBEDTLS_HARDWARE_MPI=y
CONFIG_MBEDTLS_MPI_USE_INTERRUPT=y
CONFIG_MBEDTLS_HARDWARE_SHA=y

# HTTP Client
CONFIG_ESP_HTTP_CLIENT_ENABLE_HTTPS=y

# Log level
CONFIG_LOG_DEFAULT_LEVEL_INFO=y

# Main task
CONFIG_ESP_MAIN_TASK_STACK_SIZE=8192
```
